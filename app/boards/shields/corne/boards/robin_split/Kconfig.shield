## app/boards/shields/corne/boards/robin_split/Kconfig.shield
```kconfig
config SHIELD_ROBIN_SPLIT_LEFT
    def_bool $(shields_list_contains,robin_split_left)

config SHIELD_ROBIN_SPLIT_RIGHT
    def_bool $(shields_list_contains,robin_split_right)
```

## app/boards/shields/robin_split/Kconfig.defconfig
```kconfig
if SHIELD_ROBIN_SPLIT_LEFT

config ZMK_KEYBOARD_NAME
    default "Robin Split"

config ZMK_SPLIT_ROLE_CENTRAL
    default y

endif

if SHIELD_ROBIN_SPLIT_LEFT || SHIELD_ROBIN_SPLIT_RIGHT

config ZMK_SPLIT
    default y

endif
```
